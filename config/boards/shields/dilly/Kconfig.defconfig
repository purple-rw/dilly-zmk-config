## config/boards/shields/dilly/Kconfig.defconfig
```kconfig
# Copyright (c) 2021 purple-rw
# SPDX-License-Identifier: MIT

if SHIELD_DILLY

config ZMK_KEYBOARD_NAME
    default "Dilly"

endif

if ZMK_BACKLIGHT

config PWM
    default y

config LED_PWM
    default y

endif # ZMK_BACKLIGHT
```

## config/boards/shields/dilly/Kconfig.shield
```kconfig
# Copyright (c) 2021 purple-rw
# SPDX-License-Identifier: MIT

config SHIELD_DILLY
    def_bool $(shields_list_contains,dilly)
```
